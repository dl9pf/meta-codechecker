## conf/layer.conf
```bitbake
# We have a conf and classes directory, add to BBPATH
BBPATH .= ":${LAYERDIR}"

# We have recipes-* directories, add to BBFILES
BBFILES += "${LAYERDIR}/recipes-*/*/*.bb \
	${LAYERDIR}/recipes-*/*/*.bbappend"

BBFILE_COLLECTIONS += "codechecker"
BBFILE_PATTERN_codechecker = "^${LAYERDIR}/"
BBFILE_PRIORITY_codechecker = "70"

LAYERSERIES_COMPAT_codechecker = "dunfell"
LAYERDEPENDS_codechecker = "core clang-layer meta-python"
```
